## configs/arm_cortexm_sdk_defconfig
```kconfig
BR2_arm=y
BR2_cortex_m7=y
BR2_ARM_ENABLE_VFP=y
BR2_ARM_EABI=y
BR2_ARM_FPU_FPV4D16=y
BR2_KERNEL_HEADERS_5_15=y
BR2_TOOLCHAIN_BUILDROOT_WCHAR=y
BR2_PTHREAD_DEBUG=y
BR2_TOOLCHAIN_BUILDROOT_CXX=y
BR2_PACKAGE_HOST_GDB=y
BR2_GDB_VERSION_11=y
BR2_SHARED_STATIC_LIBS=y
BR2_INIT_NONE=y
# BR2_PACKAGE_BUSYBOX is not set
BR2_PACKAGE_BZIP2=y
BR2_PACKAGE_GDB=y
BR2_PACKAGE_JQ=y
BR2_PACKAGE_LIBUBOOTENV=y
BR2_PACKAGE_LIBARCHIVE=y
BR2_PACKAGE_LIBSODIUM=y
BR2_PACKAGE_OPENSSL=y
BR2_PACKAGE_SQLITE=y
BR2_PACKAGE_EXPAT=y
BR2_PACKAGE_JSONCPP=y
BR2_PACKAGE_LIBCURL=y
BR2_PACKAGE_LIBCURL_CURL=y
BR2_PACKAGE_LIBTIRPC=y
BR2_PACKAGE_BOOST=y
BR2_PACKAGE_BOOST_JSON=y
BR2_PACKAGE_BOOST_LOG=y
BR2_PACKAGE_BOOST_PROGRAM_OPTIONS=y
BR2_PACKAGE_URANDOM_SCRIPTS=y
BR2_PACKAGE_AKTUALIZR=y
BR2_PACKAGE_LIBOSTREE=y
BR2_PACKAGE_UTIL_LINUX=y
BR2_PACKAGE_UTIL_LINUX_LIBBLKID=y
BR2_PACKAGE_UTIL_LINUX_LIBUUID=y
BR2_TARGET_ROOTFS_TAR_XZ=y
BR2_PACKAGE_HOST_ASN1C=y
```

## configs/arm_cortexm_sdk_lite_defconfig
```kconfig
BR2_arm=y
BR2_cortex_m7=y
BR2_ARM_ENABLE_VFP=y
BR2_ARM_EABI=y
BR2_ARM_FPU_FPV4D16=y
BR2_KERNEL_HEADERS_6_12=y
BR2_TOOLCHAIN_BUILDROOT_WCHAR=y
BR2_PTHREAD_DEBUG=y
BR2_TOOLCHAIN_BUILDROOT_CXX=y
BR2_PACKAGE_HOST_GDB=y
BR2_GDB_VERSION_11=y
BR2_SHARED_STATIC_LIBS=y
BR2_INIT_NONE=y
BR2_PACKAGE_BUSYBOX_SHOW_OTHERS=y
BR2_PACKAGE_GDB=y
BR2_PACKAGE_I2C_TOOLS=y
BR2_PACKAGE_LIBUBOOTENV=y
BR2_PACKAGE_TSLIB=y
BR2_PACKAGE_DROPBEAR=y
BR2_PACKAGE_OPENSSH_SFTP_SERVER=y
BR2_PACKAGE_WPA_SUPPLICANT=y
BR2_PACKAGE_WPA_SUPPLICANT_NL80211=y
BR2_PACKAGE_WPA_SUPPLICANT_WEXT=y
BR2_PACKAGE_WPA_SUPPLICANT_WIRED=y
BR2_PACKAGE_WPA_SUPPLICANT_CLI=y
BR2_PACKAGE_BT_TOOLS=y
```

## package/aktualizr/Config.in
```kconfig
config BR2_PACKAGE_AKTUALIZR
	bool "Aktualizr"
	depends on BR2_PACKAGE_LIBOSTREE
	depends on BR2_PACKAGE_BOOST
	depends on BR2_PACKAGE_LIBCURL
	depends on BR2_PACKAGE_LIBOPENSSL
	depends on BR2_PACKAGE_LIBARCHIVE
	depends on BR2_PACKAGE_LIBSODIUM
	depends on BR2_PACKAGE_SQLITE
	depends on BR2_PACKAGE_HOST_ASN1C
	depends on BR2_PACKAGE_JSONCPP
	help
	  C++ implementation of Uptane OTA update client.
```

## package/bt-tools/Config.in
```kconfig
config BR2_PACKAGE_BT_TOOLS
	bool "bt-tools (legacy BlueZ 2.25 + OBEX)"
	depends on !BR2_STATIC_LIBS
	help
	  Legacy Bluetooth user-space stack: BlueZ 2.25 (hcid, sdpd,
	  hcitool, sdptool, rfcomm), OpenOBEX and obexftp. Classic BR/EDR
	  only, no BLE.

	  noMMU/FDPIC capable: built with fork() redefined to vfork(). The
	  source tree is supplied via BT_TOOLS_OVERRIDE_SRCDIR, the same way
	  busybox is built from an in-tree source.

comment "bt-tools needs a toolchain w/ dynamic library support"
	depends on BR2_STATIC_LIBS
```

## package/can-tests/Config.in
```kconfig
config BR2_PACKAGE_CAN_TESTS
	bool "can-tests"
	help
	  Test programs for the Linux SocketCAN stack: raw, BCM,
	  gateway and netlayer tests such as tst-raw, tst-filter and
	  tst-rcv-own-msgs.

	  https://github.com/linux-can/can-tests
```

## package/libassuan/Config.in
```kconfig
config BR2_PACKAGE_LIBASSUAN
	bool "libassuan"
	depends on BR2_PACKAGE_LIBGPG_ERROR_ARCH_SUPPORTS # libgpg-error
	depends on BR2_USE_MMU || ((BR2_arm || BR2_armeb) && BR2_BINFMT_FDPIC) # fork()
	select BR2_PACKAGE_LIBGPG_ERROR
	help
	  Libassuan is a small library implementing the so-called
	  Assuan protocol.

	  This protocol is used for IPC between most newer GnuPG
	  components. Both, server and client side functions are
	  provided.

	  http://www.gnupg.org/related_software/libassuan/
```

## package/openssh-sftp-server/Config.in
```kconfig
config BR2_PACKAGE_OPENSSH_SFTP_SERVER
	bool "openssh-sftp-server"
	select BR2_PACKAGE_ZLIB
	help
	  SFTP server from OpenSSH. This is a standalone helper program
	  that handles SFTP protocol over stdin/stdout, typically spawned
	  by an SSH server (e.g., dropbear) on incoming SFTP connections.

	  Unlike the full openssh package, sftp-server does not use
	  fork() and works on noMMU targets.

	  https://www.openssh.com/
```
